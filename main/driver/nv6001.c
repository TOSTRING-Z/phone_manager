#include "freertos/FreeRTOS.h"
#include "freertos/task.h"
#include "esp_timer.h"
#include "esp_lcd_panel_io.h"
#include "esp_lcd_panel_vendor.h"
#include "esp_lcd_panel_ops.h"
#include "esp_lcd_panel_commands.h"
#include "driver/gpio.h"
#include "driver/spi_master.h"
#include "esp_err.h"
#include "esp_log.h"
#include "lvgl.h"
#include "nv6001.h"

spi_device_handle_t spi;

// lcd操作句柄
static esp_lcd_panel_io_handle_t lcd_io_handle = NULL;

// 刷新完成回调函数
static lcd_flush_done_cb s_flush_done_cb = NULL;

static const lcd_init_cmd_t lcd_init_cmds[] = {
	{0xC0, {0x5A, 0x5A}, 2},
	{0xC1, {0x5A, 0x5A}, 2},
	{0xD0, {0x10}, 1},
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	{0, {0}, 0xff}};

// OLED软件初始化函数
void lcd_init(spi_device_handle_t spi)
{
	int cmd = 0;

	// Initialize non-SPI GPIOs
	gpio_config_t io_conf = {};
	io_conf.pin_bit_mask = ((1ULL << DC_PIN) | (1ULL << RST_PIN));
	io_conf.mode = GPIO_MODE_OUTPUT;
	io_conf.pull_up_en = true;
	gpio_config(&io_conf);

	// Reset the display
	gpio_set_level(RST_PIN, 0);
	vTaskDelay(100 / portTICK_PERIOD_MS);
	gpio_set_level(RST_PIN, 1);

	// Send all the commands
	while (lcd_init_cmds[cmd].databytes != 0xff)
	{
		if (lcd_init_cmds[cmd].databytes & 0x80)
        {
        	esp_lcd_panel_io_tx_param(lcd_io_handle, lcd_init_cmds[cmd].cmd, NULL, 0);
        }
		else {
			esp_lcd_panel_io_tx_param(lcd_io_handle, lcd_init_cmds[cmd].cmd, lcd_init_cmds[cmd].data, lcd_init_cmds[cmd].databytes & 0xFF);
		}
		cmd++;
	}
}

/** nv6001写入显示数据
 * @param x1,x2,y1,y2:显示区域
 * @return 无
 */
void nv6001_flush(int ypos, void *data, size_t len)
{
	// define an area of frame memory where MCU can access
	if (ypos > (ROW - PARALLEL_LINES))
	{
		if (s_flush_done_cb)
			s_flush_done_cb(NULL);
		return;
	}
	esp_lcd_panel_io_tx_param(lcd_io_handle,
							  LCD_CMD_CASET,
							  (uint8_t[]){
								  0,
								  0,
								  ((COL - 1) >> 8) & 0xFF,
								  (COL - 1) & 0xFF,
							  },
							  4);
	esp_lcd_panel_io_tx_param(lcd_io_handle,
							  LCD_CMD_RASET,
							  (uint8_t[]){
								  (ypos >> 8) & 0xFF,
								  ypos & 0xFF,
								  ((ypos + PARALLEL_LINES - 1) >> 8) & 0xFF,
								  (ypos + PARALLEL_LINES - 1) & 0xFF,
							  },
							  4);
	esp_lcd_panel_io_tx_param(lcd_io_handle, LCD_CMD_RAMWR, NULL, 0);
	esp_lcd_panel_io_tx_param(lcd_io_handle, LCD_CMD_RAMWR, NULL, 0);
	esp_lcd_panel_io_tx_param(lcd_io_handle, -1, data, len);

	return;
}

void write_line(int pl,uint16_t color)
{
	// 计算数组的大小
	size_t array_size = COL * PARALLEL_LINES * sizeof(uint16_t);

	// 动态分配 uint8_t 数组
	uint8_t *data = (uint8_t *)malloc(array_size);
	if (data == NULL)
	{
		fprintf(stderr, "内存分配失败\n");
		return;
	}

	// 填充 data 数组
	for (size_t i = 0; i < COL * PARALLEL_LINES; i++)
	{
		data[i * 2] = (uint8_t)(color >> 8);	   // 高位字节
		data[i * 2 + 1] = (uint8_t)(color & 0xFF); // 低位字节
	}

	nv6001_flush(pl * PARALLEL_LINES, data, COL * PARALLEL_LINES * 2);

	// 释放内存
	free(data);
}

// 填充屏幕颜色
void display_color(uint16_t color)
{
	for (size_t pl = 0; pl < ROW / PARALLEL_LINES; pl++)
	{
		write_line(pl,color);
	}
}

static bool notify_flush_ready(esp_lcd_panel_io_handle_t panel_io, esp_lcd_panel_io_event_data_t *edata, void *user_ctx)
{
	if (s_flush_done_cb)
		s_flush_done_cb(user_ctx);
	return false;
}

// OLED屏幕整体初始化(包括软硬件)函数
void nv6001_init()
{
	esp_err_t ret;

	spi_bus_config_t buscfg = {
		.mosi_io_num = MOSI_PIN,
		.sclk_io_num = SCK_PIN,
		.miso_io_num = -1,
		.quadwp_io_num = -1,
		.quadhd_io_num = -1,
		.max_transfer_sz = COL * PARALLEL_LINES * sizeof(uint16_t),
		.flags = SPICOMMON_BUSFLAG_MASTER, // SPI主模式
	};

	// Initialize the SPI bus
	ret = spi_bus_initialize(SPI_BUS, &buscfg, SPI_DMA_CH_AUTO);
	ESP_ERROR_CHECK(ret);

	// 创建基于spi的lcd操作句柄
	esp_lcd_panel_io_spi_config_t io_config = {
		.dc_gpio_num = DC_PIN,					   // DC引脚
		.cs_gpio_num = CS_PIN,					   // CS引脚
		.pclk_hz = 40 * 1000 * 1000,			   // SPI时钟频率
		.lcd_cmd_bits = 8,						   // 命令长度
		.lcd_param_bits = 8,					   // 参数长度
		.spi_mode = 0,							   // 使用SPI0模式
		.trans_queue_depth = 10,				   // 表示可以缓存的spi传输事务队列深度
		.on_color_trans_done = notify_flush_ready, // 刷新完成回调函数
		.user_ctx = NULL,						   // 回调函数参数
		.flags = {
			// 以下为 SPI 时序的相关参数，需根据 LCD 驱动 IC 的数据手册以及硬件的配置确定
			.sio_mode = 0, // 通过一根数据线（MOSI）读写数据，0: Interface I 型，1: Interface II 型
		},
	};
	// Attach the LCD to the SPI bus
	ret = esp_lcd_new_panel_io_spi((esp_lcd_spi_bus_handle_t)SPI_BUS, &io_config, &lcd_io_handle);
	ESP_ERROR_CHECK(ret);

	// Initialize the LCD
	lcd_init(spi);

	display_color(0x0000);
}

// 刷新显示缓冲区的回调函数
void nv6001_lv_fb_flush(lv_disp_drv_t *disp, const lv_area_t *area, lv_color_t *color_map)
{
	// 通知LVGL刷新完成
	lv_disp_flush_ready(disp);
}
